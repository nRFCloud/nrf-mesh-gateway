## CMakeLists.txt
```
cmake_minimum_required(VERSION 3.13.1)

set(BOARD_ROOT ${CMAKE_CURRENT_LIST_DIR})

set(HW_VERSION_MAJOR "0")
set(HW_VERSION_MINOR "9")
set(FW_VERSION_MAJOR "0")
set(FW_VERSION_MINOR "0")

find_package(Zephyr REQUIRED HINTS $ENV{ZEPHYR_BASE})
project(lte-btmesh-gateway)
zephyr_compile_definitions(PROJECT_NAME=${PROJECT_NAME})
zephyr_compile_definitions(_POSIX_C_SOURCE_200809L)

# NORDIC SDK APP START
target_sources(app PRIVATE src/main.c)
# NORDIC SDK APP END
zephyr_include_directories(src)

# Include application events and configuration headers
zephyr_library_include_directories(
src
src/watchdog
)

find_package(Git QUIET REQUIRED)

execute_process(
    COMMAND "${GIT_EXECUTABLE}" describe --always HEAD
    WORKING_DIRECTORY "${CMAKE_SOURCE_DIR}"
    RESULT_VARIABLE res
    OUTPUT_VARIABLE MYAPP_VERSION
    ERROR_QUIET
    OUTPUT_STRIP_TRAILING_WHITESPACE)

set_property(GLOBAL APPEND
    PROPERTY CMAKE_CONFIGURE_DEPENDS
    "${CMAKE_SOURCE_DIR}/.git/index")

if ("${MYAPP_VERSION}" MATCHES "^.*-(.*)-g.*$")
    # if HEAD is tagged with a form of major.minor.patch this separates the items and uses them instead
    string(REGEX REPLACE "^([0-9]+)\\.([0-9]+)\\.([0-9]+).*$" "\\1;\\2;\\3" _ver_parts "${MYAPP_VERSION}")
    list(GET _ver_parts 0 FW_VERSION_MAJOR)
    list(GET _ver_parts 1 FW_VERSION_MINOR)
    list(GET _ver_parts 2 FW_VERSION_PATCH)
else ()
    set(FW_VERSION_PATCH ${MYAPP_VERSION})
endif ()

#
# utilize settings to autogenerate a header file to adjust the build inside the C code
#
configure_file (
   "src/config.h.in"
   "${PROJECT_SOURCE_DIR}/src/config.h"
   )

target_sources(app PRIVATE src/btmesh.c)
target_sources_ifdef(CONFIG_SHELL app PRIVATE src/cli.c)
target_sources(app PRIVATE src/codec.c)
target_sources(app PRIVATE src/gateway.c)
target_sources(app PRIVATE src/gw_cloud.c)
target_sources(app PRIVATE src/lte.c)
target_sources(app PRIVATE src/util.c)
add_subdirectory_ifdef(CONFIG_WATCHDOG src/watchdog)
```

## Kconfig
```
menu "nRF Cloud Mesh Gateway App"

config APPLICATION_WORKQUEUE_STACK_SIZE
        int "Application workqueue stack size"
        default 4096

config APPLICATION_WORKQUEUE_PRIORITY
        int "Application workqueue priority"
        default SYSTEM_WORKQUEUE_PRIORITY

menu "Device and modem"

config POWER_OPTIMIZATION_ENABLE
	bool "Enable power optimization"
	default y
	select LTE_EDRX_REQ

endmenu # Device

menu "Cloud"

config MQTT_KEEPALIVE
        int "Time after last transmission to send a ping to keep connection on"
        default 1200
        help
          This should be set to the expected time between messages sent from
          this device. Making it larger than the expected data period does not
          conserve bandwidth, as the ping is only sent if nothing else
          has been within the specified period. Shorter values can prevent hidden
          NAT timeouts at the carrier, but also will interrupt GPS fix attempts
          and slow down TTFF.

config LTE_CONNECT_RETRY_DELAY
    int "LTE connection retry delay in seconds"
    default 480
    help
        Time to wait before trying to connect to LTE again if the previous
        attempt failed (in seconds).

config CLOUD_CONNECT_RETRY_DELAY
        int "Cloud connection retry delay in seconds"
        default 480
        help
          Time to wait before trying to connect to the cloud again if the
          previous attempt failed (in seconds).

config CLOUD_CONNECT_COUNT_MAX
        int "Maximum number of cloud connection attempts"
        default 8

config CLOUD_WAIT_DURATION
        int "Cloud connection acknowledge wait duration"
        default 30
        help
          How long the device should wait for a CONNACK
          event from the cloud.

config CLOUD_CONNECT_ERR_REBOOT_S
        int "Seconds to wait before rebooting when a cloud connect error occurs"
        default 300

endmenu # Cloud

choice
        prompt "GPS device"
        default GPS_USE_SIM
        help
            Select from which device GPS data will be fetched.

config GPS_USE_SIM
        bool "Use GPS simulator"
        select GPS_SIM
        select GPS_SIM_TRIGGER
        help
            Use simulated GPS data.

config GPS_USE_EXTERNAL
        bool "User provided GPS device"
        help
            Provide a GPS device that location data will be fetched from and
            sent to nRF Cloud

endchoice

if GPS_USE_SIM

config GPS_DEV_NAME
        string
        default GPS_SIM_DEV_NAME

config GPS_TRIGGER
        bool
        default GPS_SIM_TRIGGER

endif

if GPS_USE_EXTERNAL
config GPS_DEV_NAME
        string "GPS device name"
        help
            GPS device from which location data will be fetched and sent
            to nRF Cloud.

endif

config WATCHDOG_TIMEOUT_MSEC
        int "Watchdog timeout in milliseconds"
        default 10000

config BT_MESH_GATEWAY_SUB_LIST_LEN
        int "Bluetooth Mesh Gateway subscription List Length"
        default 0
        help
            List of Bluetooth Mesh addresses for message destinations that should
            be relayed to the cloud.

config SHELL_MESH_HEALTH
	bool "Mesh health model configuration support via the UART shell"
	default n
	help
		Defines if the UART shell should support commands for configuring remote mesh node
		health models.

config SHELL_MESH_HEARTBEAT
	bool "Mesh node heartbeat configuration support via the UART shell"
	default n
	help
		Defines if the UART shell should support commands for configuring remote mesh node
		heartbeats.

config SHELL_MESH_SIG
	bool "SIG defined mesh model configuration support via the UART shell"
	default n
	help
		Defines if the UART shell should support commands for configuraing SIG defined
		mesh models.

config SHELL_MESH_VND
	bool "Vendor defined mesh model configuration support via the UART shell"
	default n
	help
		Defines if the UART shell should support commands for configuraing vendor defined
		mesh models.

config SHELL_MESH_MSG
	bool "Direct mesh access layer message support via the UART shell"
	default n
	help
		Defines if the UART shell should support commands for sending mesh access layer
		messages directly from the application without instantiated models.

endmenu

menu "Zephyr Kernel"
source "Kconfig.zephyr"
endmenu

module = NRF_CLOUD_MESH_GATEWAY
module-str = nRF Cloud Mesh Gateway
source "${ZEPHYR_BASE}/subsys/logging/Kconfig.template.log_config"
```

## sample.yaml
```
sample:
  name: Mesh Gateway
```

## west.yml
```
manifest:
  remotes:
    - name: nrfcloud
      url-base: https://github.com/nRFCloud
    - name: nordic
      url-base: https://github.com/nrfconnect
    - name: origin
      url-base: https://github.com/BudkoEmbedded
  projects:
    - name: sdk-nrf
      path: nrf
      remote: nordic
      revision: main
      import: true
  self:
    path: mesh-gateway
```

## prj.conf
```kconfig
# General Config
CONFIG_NEWLIB_LIBC=y
CONFIG_NEWLIB_LIBC_FLOAT_PRINTF=y   # Needed for cJSON number handling.
CONFIG_ASSERT=y
CONFIG_REBOOT=y
CONFIG_FW_INFO=y

# Fatal error
CONFIG_RESET_ON_FATAL_ERROR=n
CONFIG_WATCHDOG=n

# Heap and stacks
CONFIG_HEAP_MEM_POOL_SIZE=16384
CONFIG_MAIN_STACK_SIZE=8192
CONFIG_SYSTEM_WORKQUEUE_STACK_SIZE=4096
CONFIG_APPLICATION_WORKQUEUE_STACK_SIZE=1024
CONFIG_SHELL_STACK_SIZE=2048
CONFIG_HW_STACK_PROTECTION=y

# Settings Config
CONFIG_FLASH=y
CONFIG_FLASH_PAGE_LAYOUT=y
CONFIG_FLASH_MAP=y
CONFIG_NVS=y
CONFIG_SETTINGS=y
CONFIG_FCB=y
CONFIG_SETTINGS_FCB=y
CONFIG_MPU_ALLOW_FLASH_WRITE=y

# Force GPS_SIM off to save 2KB of RAM:
CONFIG_GPS_USE_EXTERNAL=y
CONFIG_GPS_USE_SIM=n
CONFIG_GPS_SIM=n

# Network Config
CONFIG_NETWORKING=y
CONFIG_NET_NATIVE=n
CONFIG_NET_SOCKETS=y
CONFIG_NET_SOCKETS_OFFLOAD=y

# LTE Config
CONFIG_POWER_OPTIMIZATION_ENABLE=n
CONFIG_LTE_LINK_CONTROL=y
CONFIG_LTE_NETWORK_MODE_LTE_M_GPS=n
CONFIG_LTE_AUTO_INIT_AND_CONNECT=n
CONFIG_LTE_NETWORK_MODE_NBIOT=n
CONFIG_LTE_PSM_REQ_RPTAU="00000110"
CONFIG_LTE_PSM_REQ_RAT="00000010"
CONFIG_LTE_LOCK_BANDS=y
CONFIG_LTE_LOCK_BAND_MASK="1000000010000001100010001110"  # Enable band 2, 3, 4, 8, 12, 13, 20 and 28
CONFIG_LTE_CONNECT_RETRY_DELAY=10

# Modem Info Config
CONFIG_MODEM_INFO=y
CONFIG_MODEM_INFO_ADD_DATE_TIME=n
CONFIG_MODEM_INFO_ADD_SIM_ICCID=n
CONFIG_NRF_MODEM_LIB=y
CONFIG_NRF_MODEM_LIB_TRACE_ENABLED=n

# AT Modem Libs
CONFIG_AT_CMD=y
CONFIG_AT_CMD_THREAD_STACK_SIZE=1024
CONFIG_AT_HOST_LIBRARY=n # AT command uart bridge for modem

# nRF Cloud Config
CONFIG_CLOUD_API=y
CONFIG_NRF_CLOUD_MQTT=y
CONFIG_NRF_CLOUD_CONNECTION_POLL_THREAD=y
CONFIG_CJSON_LIB=y  # Needed for the cloud codec
# Shorter to prevent NAT timeouts
CONFIG_MQTT_KEEPALIVE=120
# Don't resubscribe to topics if broker remembers them
CONFIG_MQTT_CLEAN_SESSION=n
# Set maximum recievable payload size
CONFIG_NRF_CLOUD_MQTT=y
CONFIG_NRF_CLOUD_MQTT_PAYLOAD_BUFFER_LEN=2048

CONFIG_NRF_CLOUD_SEND_NONBLOCKING=n
# use our nrf_socket.h workaround instead of bsdlib fix
CONFIG_NRF91_SOCKET_SEND_SPLIT_LARGE_BLOCKS=n
CONFIG_CLOUD_CONNECT_RETRY_DELAY=10
CONFIG_NRF_CLOUD_CLIENT_ID_SRC_RUNTIME=n

# Switch to new certs and device ID method
CONFIG_NRF_CLOUD_CLIENT_ID_SRC_INTERNAL_UUID=y
CONFIG_MODEM_JWT=y
CONFIG_NRF_CLOUD_SEC_TAG=42

# MCU Boot
#CONFIG_BOOTLOADER_MCUBOOT=y
#CONFIG_IMG_MANAGER=y
#CONFIG_MCUBOOT_IMG_MANAGER=y
#CONFIG_IMG_ERASE_PROGRESSIVELY=y
##CONFIG_SECURE_BOOT=y
##CONFIG_BUILD_S1_VARIANT=y

# Date Time Lib
CONFIG_DATE_TIME=y
CONFIG_DATE_TIME_MODEM=n
CONFIG_DATE_TIME_NTP=y
CONFIG_DATE_TIME_LOG_LEVEL_DBG=y

# Console
CONFIG_CONSOLE_SUBSYS=n
CONFIG_CONSOLE_HANDLER=n
CONFIG_CONSOLE_GETCHAR=n

# Bluetooth HCI Config
CONFIG_BT_H4=y
CONFIG_BT_HCI=y
CONFIG_BT_WAIT_NOP=y
CONFIG_BT_HCI_MESH_EXT=y
CONFIG_BT_TINYCRYPT_ECC=y
CONFIG_UART_INTERRUPT_DRIVEN=y
CONFIG_NRFX_TIMER2=y

# Bluetooth Config
CONFIG_BT=y
CONFIG_BT_OBSERVER=y
CONFIG_BT_BROADCASTER=y
CONFIG_BT_SETTINGS=y
CONFIG_BT_LL_SW_SPLIT=y

# Disable Unused Bluetooth Features
CONFIG_BT_CTLR_LE_ENC=n
CONFIG_BT_DATA_LEN_UPDATE=n
CONFIG_BT_PHY_UPDATE=n
CONFIG_BT_CTLR_CHAN_SEL_2=n
CONFIG_BT_CTLR_MIN_USED_CHAN=n
CONFIG_BT_CTLR_PRIVACY=n

# Mesh Config
CONFIG_BT_MESH=y
CONFIG_BT_MESH_TX_SEG_MSG_COUNT=3
CONFIG_BT_MESH_RX_SEG_MSG_COUNT=3
CONFIG_BT_MESH_TX_SEG_MAX=10
CONFIG_BT_MESH_RX_SEG_MAX=10
CONFIG_BT_MESH_ADV_BUF_COUNT=10
CONFIG_BT_MESH_RPL_STORE_TIMEOUT=600
CONFIG_BT_MESH_ACCESS_LAYER_MSG=y # Used for gateway direct access to model messages and access layer.

# Mesh Provisioner Config
CONFIG_BT_MESH_PROVISIONER=y
CONFIG_BT_MESH_PROV_DEVICE=n
CONFIG_BT_MESH_PB_ADV=y
#CONFIG_BT_MESH_PB_GATT=y

# Mesh Node Config
CONFIG_BT_MESH_CFG_CLI=y
CONFIG_BT_MESH_HEALTH_CLI=y
CONFIG_BT_MESH_SUBNET_COUNT=5
CONFIG_BT_MESH_APP_KEY_COUNT=5
CONFIG_BT_MESH_MODEL_GROUP_COUNT=5
CONFIG_BT_MESH_GATEWAY_SUB_LIST_LEN=20

# Mesh Feature Config
CONFIG_BT_MESH_BEACON_ENABLED=n
#CONFIG_BT_MESH_RELAY=y
#CONFIG_BT_MESH_FRIEND=y
#CONFIG_BT_MESH_GATT_PROXY=y

# Mesh CDB Config
CONFIG_BT_MESH_CDB=y
CONFIG_BT_MESH_CDB_NODE_COUNT=10
CONFIG_BT_MESH_CDB_APP_KEY_COUNT=5
CONFIG_BT_MESH_CDB_SUBNET_COUNT=5

# Shell Config
CONFIG_SHELL=y
CONFIG_SHELL_ARGC_MAX=14
CONFIG_SHELL_WILDCARD=n
#CONFIG_INIT_STACKS=y
#CONFIG_THREAD_STACK_INFO=y
#CONFIG_KERNEL_SHELL=y
#CONFIG_THREAD_MONITOR=y
CONFIG_BOOT_BANNER=n
#CONFIG_THREAD_NAME=y
#CONFIG_DEVICE_SHELL=y
CONFIG_POSIX_CLOCK=y
#CONFIG_DATE_SHELL=y
CONFIG_SHELL_PROMPT_UART="meshgw:# "

# App Shell Config
CONFIG_SHELL_MESH_HEALTH=y
CONFIG_SHELL_MESH_HEARTBEAT=y
CONFIG_SHELL_MESH_SIG=y
CONFIG_SHELL_MESH_VND=y
CONFIG_SHELL_MESH_MSG=y

# Logging Config
CONFIG_LOG=y
#CONFIG_NET_LOG=y
CONFIG_NRF_CLOUD_MESH_GATEWAY_LOG_LEVEL_DBG=y
#CONFIG_LTE_LINK_CONTROL_LOG_LEVEL_DBG=y
CONFIG_NRF_CLOUD_LOG_LEVEL_DBG=y
CONFIG_NET_LOG=n
CONFIG_MQTT_LOG_LEVEL_INF=n
CONFIG_LOG_MODE_IMMEDIATE=n
CONFIG_LOG_DEFAULT_LEVEL=3
CONFIG_LOG_FUNC_NAME_PREFIX_INF=y
CONFIG_LOG_FUNC_NAME_PREFIX_ERR=y
CONFIG_LOG_PRINTK=y
CONFIG_LOG_STRDUP_BUF_COUNT=128
CONFIG_LOG_STRDUP_MAX_STRING=128

# Debug Config
CONFIG_PRINTK=y
CONFIG_BT_DEBUG_LOG=y
CONFIG_BT_DEBUG_CONN=y
CONFIG_BT_DEBUG_GATT=y
CONFIG_BT_DEBUG_HCI_CORE=n
CONFIG_BT_DEBUG_HCI_DRIVER=n

CONFIG_BT_MESH_DEBUG=y
#CONFIG_BT_MESH_DEBUG_ACCESS=y
#CONFIG_BT_MESH_DEBUG_TRANS=y # CAUSES HARD FAULTS ON SOME DBG PRINT
#CONFIG_BT_MESH_DEBUG_KEYS=y
#CONFIG_BT_MESH_DEBUG_CDB=y
#CONFIG_BT_MESH_DEBUG_CRYPTO=y
#CONFIG_BT_MESH_DEBUG_MODEL=y
#CONFIG_BT_MESH_DEBUG_SETTINGS=y
#CONFIG_BT_MESH_DEBUG_ADV=y
#CONFIG_BT_MESH_DEBUG_PROV=y
#CONFIG_BT_MESH_DEBUG_BEACON=y
#CONFIG_BT_MESH_DEBUG_NET=y
```

## src/main.c
```c
#include <zephyr.h>
#include <logging/log.h>
#include <logging/log_ctrl.h>
#include <power/reboot.h>
#include <string.h>
#include <shell/shell_uart.h>

#include "btmesh.h"
#ifdef CONFIG_SHELL
#include "cli.h"
#endif
#include "error.h"
#include "gw_cloud.h"
#include "config.h"
#include "lte.h"
#include "watchdog.h"

LOG_MODULE_REGISTER(app_main, CONFIG_NRF_CLOUD_MESH_GATEWAY_LOG_LEVEL);

K_THREAD_STACK_DEFINE(application_stack_area,
        CONFIG_APPLICATION_WORKQUEUE_STACK_SIZE);
static struct k_work_q application_work_q;


static void error_handler(enum error_type err_type, int err_code)
{
    gw_cloud_error_callback();

    if (err_type == ERROR_CLOUD) {
        lte_shutdown_modem();
    }

#if !defined(CONFIG_DEBUG) && defined(CONFIG_REBOOT)
    LOG_PANIC();
    sys_reboot(0);
#else
        
    switch (err_type) {
    case ERROR_CLOUD:
        /* Blinking all LEDs ON/OFF in pairs (1 and 4, 2 and 3)
         * if there is an application error.
         */
        // TODO ui_led_set_pattern(UI_LED_ERROR_CLOUD);
        LOG_ERR("Error of type ERROR_CLOUD: %d", err_code);
        break;
    case ERROR_MODEM_RECOVERABLE:
        /* Blinking all LEDs ON/OFF in pairs (1 and 3, 2 and 4)
         * if there is a recoverable error.
         */
        // TODO ui_led_set_pattern(UI_LED_ERROR_MODEM_REC);
        LOG_ERR("Error of type ERROR_MODEM_RECOVERABLE: %d", err_code);
        break;
    case ERROR_MODEM_IRRECOVERABLE:
        /* Blinking all LEDs ON/OFF if there is an irrecoverable error.
         */
        //TODO ui_led_set_pattern(UI_LED_ERROR_BSD_IRREC);
        LOG_ERR("Error of type ERROR_MODEM_IRRECOVERABLE: %d", err_code);
        break;
    default:
        /* Blinking all LEDs ON/OFF in pairs (1 and 2, 3 and 4)
         * undefined error.
         */
        // TODO ui_led_set_pattern(UI_LED_ERROR_UNKNOWN);
        LOG_ERR("Unknown error type: %d, code: %d", err_type, err_code);
          break;
    }

    while (true) {
        k_cpu_idle();
    }
#endif /* CONFIG_DEBUG */
}

void main(void)
{
    int err;
    printk("\n***********************************************\n");
    printk("nRF Cloud Mesh Gateway Starting Up...\n");
    printk("Ver:%s Built:%s\n", FW_REV_STRING, BUILT_STRING);
    printk("***********************************************\n\n");
    k_sleep(K_SECONDS(1));

#ifdef CONFIG_SHELL
    cli_init();
#endif
    err = btmesh_init();

    if (err) {
        LOG_ERR("Failed to initialize Bluetooth Mesh. Error: %d", err);
        return;
    }

    k_work_queue_start(&application_work_q, application_stack_area,
            K_THREAD_STACK_SIZEOF(application_stack_area),
            CONFIG_APPLICATION_WORKQUEUE_PRIORITY, NULL);
    k_thread_name_set(&application_work_q.thread, "application_work_q");

    if (IS_ENABLED(CONFIG_WATCHDOG)) {
        watchdog_init_and_start(&application_work_q);
    }

    err = gateway_init(&application_work_q);

    if (err) {
        LOG_ERR("Failed to initialize Gateway. Error: %d", err);
        return;
    }

    err = lte_init(&application_work_q, &error_handler);

    if (err) {
        LOG_ERR("Failed to initialize LTE. Error: %d", err);
        return;
    }

    err = gw_cloud_init(&application_work_q, &error_handler);

    if (err) {
        LOG_ERR("Failed to initialize Gateway Cloud. Error: %d", err);
        return;
    }
}
```

## src/btmesh.h
```c
#ifndef BTMESH_H_
#define BTMESH_H_


#ifdef __cplusplus
extern "C" {
#endif


#include <bluetooth/mesh.h>

#include "util.h"

#define PRIMARY_SUBNET 0x0000

struct btmesh_feature {
        bool state;
        bool support;
};

struct btmesh_relay_feature {
        bool state;
        bool support;
        uint8_t count;
        uint16_t interval;
};

struct btmesh_sig_model {
        uint16_t model_id;
        size_t appkey_count;
        uint16_t *appkey_idxs;
        size_t sub_addr_count;
        uint16_t *sub_addrs;
        struct bt_mesh_cfg_mod_pub pub;
};

struct btmesh_vnd_model {
        uint16_t company_id;
        uint16_t model_id;
        size_t appkey_count;
        uint16_t *appkey_idxs;
        size_t sub_addr_count;
        uint16_t *sub_addrs;
        struct bt_mesh_cfg_mod_pub pub;
};

struct btmesh_elem {
        uint16_t addr;
        uint16_t loc;
        size_t sig_model_count;
        size_t vnd_model_count;
        struct btmesh_sig_model *sig_models;
        struct btmesh_vnd_model *vnd_models;
};

struct btmesh_node {
        uint8_t uuid[UUID_LEN];
        uint16_t net_idx;
        uint16_t addr;
        uint16_t cid;
        uint16_t pid;
        uint16_t vid;
        uint16_t crpl;
        bool net_beacon_state;
        uint8_t ttl;
	struct bt_mesh_cfg_hb_sub hb_sub;
	struct bt_mesh_cfg_hb_pub hb_pub;
        struct btmesh_relay_feature relay;
        struct btmesh_feature proxy;
        struct btmesh_feature friend;
        bool lpn;
        size_t subnet_count;
        uint16_t *subnet_idxs;
        size_t elem_count;
        struct btmesh_elem *elems;
};

enum btmesh_op
{
        BTMESH_OP_PROV_ADV,
        BTMESH_OP_NODE_RESET,
        BTMESH_OP_COMP_GET,
        BTMESH_OP_BEACON_GET,
        BTMESH_OP_BEACON_SET,
        BTMESH_OP_TTL_GET,
        BTMESH_OP_TTL_SET,
        BTMESH_OP_FRIEND_GET,
        BTMESH_OP_FRIEND_SET,
        BTMESH_OP_PROXY_GET,
        BTMESH_OP_PROXY_SET,
        BTMESH_OP_RELAY_GET,
        BTMESH_OP_RELAY_SET,
        BTMESH_OP_NET_KEY_ADD,
        BTMESH_OP_NET_KEY_GET,
        BTMESH_OP_NET_KEY_DEL,
        BTMESH_OP_APP_KEY_ADD,
        BTMESH_OP_APP_KEY_GET,
        BTMESH_OP_APP_KEY_DEL,
        BTMESH_OP_MOD_APP_BIND,
        BTMESH_OP_MOD_APP_BIND_VND,
        BTMESH_OP_MOD_APP_UNBIND,
        BTMESH_OP_MOD_APP_UNBIND_VND,
        BTMESH_OP_MOD_APP_GET,
        BTMESH_OP_MOD_APP_GET_VND,
        BTMESH_OP_MOD_PUB_GET,
        BTMESH_OP_MOD_PUB_GET_VND,
        BTMESH_OP_MOD_PUB_SET,
        BTMESH_OP_MOD_PUB_SET_VND,
        BTMESH_OP_MOD_SUB_ADD,
        BTMESH_OP_MOD_SUB_ADD_VND,
        BTMESH_OP_MOD_SUB_DEL,
        BTMESH_OP_MOD_SUB_DEL_VND,
        BTMESH_OP_MOD_SUB_OVRW,
        BTMESH_OP_MOD_SUB_OVRW_VND,
        BTMESH_OP_MOD_SUB_GET,
        BTMESH_OP_MOD_SUB_GET_VND,
        BTMESH_OP_HLTH_FAULT_GET,
        BTMESH_OP_HLTH_FAULT_CLR,
        BTMESH_OP_HLTH_FAULT_TEST,
        BTMESH_OP_HLTH_PERIOD_GET,
        BTMESH_OP_HLTH_PERIOD_SET,
        BTMESH_OP_HLTH_ATTN_GET,
        BTMESH_OP_HLTH_ATTN_SET,
        BTMESH_OP_HLTH_TIMEOUT_GET,
        BTMESH_OP_HLTH_TIMEOUT_SET,
	BTMESH_OP_HB_SUB_GET,
	BTMESH_OP_HB_SUB_SET,
	BTMESH_OP_HB_PUB_GET,
	BTMESH_OP_HB_PUB_SET
};

union btmesh_op_args {
        struct {
                uint8_t uuid[16];
                uint16_t net_idx;
                uint16_t addr;
                uint8_t attn;
        } prov_adv;
        struct {
                uint16_t net_idx;
                uint16_t addr;
                bool status;
        } node_reset;
        struct {
                uint16_t net_idx;
                uint16_t addr;
                uint8_t page;
                uint8_t status;
                struct net_buf_simple *comp;
        } comp_get;
        struct {
                uint16_t net_idx;
                uint16_t addr;
                uint8_t status;
        } beacon_get;
        struct {
                uint16_t net_idx;
                uint16_t addr;
                uint8_t val;
                uint8_t status;
        } beacon_set;
        struct {
                uint16_t net_idx;
                uint16_t addr;
                uint8_t ttl;
        } ttl_get;
        struct {
                uint16_t net_idx;
                uint16_t addr;
                uint8_t val;
                uint8_t ttl;
        } ttl_set;
        struct {
                uint16_t net_idx;
                uint16_t addr;
                uint8_t status;
        } friend_get;
        struct {
                uint16_t net_idx;
                uint16_t addr;
                uint8_t val;
                uint8_t status;
        } friend_set;
        struct {
                uint16_t net_idx;
                uint16_t addr;
                uint8_t status;
        } proxy_get;
        struct {
                uint16_t net_idx;
                uint16_t addr;
                uint8_t val;
                uint8_t status;
        } proxy_set;
        struct {
                uint16_t net_idx;
                uint16_t addr;
                uint8_t status;
                uint8_t transmit;
        } relay_get;
        struct {
                uint16_t net_idx;
                uint16_t addr;
                uint8_t new_relay;
                uint8_t new_transmit;
                uint8_t status;
                uint8_t transmit;
        } relay_set;
        struct {
                uint16_t net_idx;
                uint16_t addr;
                uint16_t key_net_idx;
                uint8_t net_key[16];
                uint8_t status;
        } net_key_add;
        struct {
                uint16_t net_idx;
                uint16_t addr;
                uint16_t keys[CONFIG_BT_MESH_SUBNET_COUNT];
                size_t key_cnt;
        } net_key_get;
        struct {
                uint16_t net_idx;
                uint16_t addr;
                uint16_t key_net_idx;
                uint8_t status;
        } net_key_del;
        struct {
                uint16_t net_idx;
                uint16_t addr;
                uint16_t key_net_idx;
                uint16_t key_app_idx;
                uint8_t app_key[16];
                uint8_t status;
        } app_key_add;
        struct {
                uint16_t net_idx;
                uint16_t addr;
                uint16_t key_net_idx;
                uint8_t status;
                uint16_t keys[CONFIG_BT_MESH_APP_KEY_COUNT];
                size_t key_cnt;
        } app_key_get;
        struct {
                uint16_t net_idx;
                uint16_t addr;
                uint16_t key_net_idx;
                uint16_t key_app_idx;
                uint8_t status;
        } app_key_del;
        struct {
                uint16_t net_idx;
                uint16_t addr;
                uint16_t elem_addr;
                uint16_t mod_app_idx;
                uint16_t mod_id;
                uint8_t status;
        } mod_app_bind;
        struct {
                uint16_t net_idx;
                uint16_t addr;
                uint16_t elem_addr;
                uint16_t mod_app_idx;
                uint16_t mod_id;
                uint8_t status;
                uint16_t cid;
        } mod_app_bind_vnd;
        struct {
                uint16_t net_idx;
                uint16_t addr;
                uint16_t elem_addr;
                uint16_t mod_app_idx;
                uint16_t mod_id;
                uint8_t status;
        } mod_app_unbind;
        struct {
                uint16_t net_idx;
                uint16_t addr;
                uint16_t elem_addr;
                uint16_t mod_app_idx;
                uint16_t mod_id;
                uint8_t status;
                uint16_t cid;
        } mod_app_unbind_vnd;
        struct {
                uint16_t net_idx;
                uint16_t addr;
                uint16_t elem_addr;
                uint16_t mod_id;
                uint8_t status;
                uint16_t apps[CONFIG_BT_MESH_APP_KEY_COUNT];
                size_t app_cnt;
        } mod_app_get;
        struct {
                uint16_t net_idx;
                uint16_t addr;
                uint16_t elem_addr;
                uint16_t mod_id;
                uint8_t status;
                uint16_t apps[CONFIG_BT_MESH_APP_KEY_COUNT];
                size_t app_cnt;
                uint16_t cid;
        } mod_app_get_vnd;
        struct {
                uint16_t net_idx;
                uint16_t addr;
                uint16_t elem_addr;
                uint16_t mod_id;
                struct bt_mesh_cfg_mod_pub pub;
                uint8_t status;
        } mod_pub_get;
        struct {
                uint16_t net_idx;
                uint16_t addr;
                uint16_t elem_addr;
                uint16_t mod_id;
                struct bt_mesh_cfg_mod_pub pub;
                uint8_t status;
                uint16_t cid;
        } mod_pub_get_vnd;
        struct {
                uint16_t net_idx;
                uint16_t addr;
                uint16_t elem_addr;
                uint16_t mod_id;
                struct bt_mesh_cfg_mod_pub pub;
                uint8_t status;
        } mod_pub_set;
        struct {
                uint16_t net_idx;
                uint16_t addr;
                uint16_t elem_addr;
                uint16_t mod_id;
                struct bt_mesh_cfg_mod_pub pub;
                uint8_t status;
                uint16_t cid;
        } mod_pub_set_vnd;
        struct {
                uint16_t net_idx;
                uint16_t addr;
                uint16_t elem_addr;
                uint16_t sub_addr;
                uint16_t mod_id;
                uint8_t status;
        } mod_sub_add;
        struct {
                uint16_t net_idx;
                uint16_t addr;
                uint16_t elem_addr;
                uint16_t sub_addr;
                uint16_t mod_id;
                uint8_t status;
                uint16_t cid;
        } mod_sub_add_vnd;
        struct {
                uint16_t net_idx;
                uint16_t addr;
                uint16_t elem_addr;
                uint16_t sub_addr;
                uint16_t mod_id;
                uint8_t status;
        } mod_sub_del;
        struct {
                uint16_t net_idx;
                uint16_t addr;
                uint16_t elem_addr;
                uint16_t sub_addr;
                uint16_t mod_id;
                uint8_t status;
                uint16_t cid;
        } mod_sub_del_vnd;
        struct {
                uint16_t net_idx;
                uint16_t addr;
                uint16_t elem_addr;
                uint16_t sub_addr;
                uint16_t mod_id;
                uint8_t status;
        } mod_sub_ovrw;
        struct {
                uint16_t net_idx;
                uint16_t addr;
                uint16_t elem_addr;
                uint16_t sub_addr;
                uint16_t mod_id;
                uint8_t status;
                uint16_t cid;
        } mod_sub_ovrw_vnd;
        struct {
                uint16_t net_idx;
                uint16_t addr;
                uint16_t elem_addr;
                uint16_t mod_id;
                uint8_t status;
                uint16_t subs[CONFIG_BT_MESH_MODEL_GROUP_COUNT];
                size_t sub_cnt;
        } mod_sub_get;
        struct {
                uint16_t net_idx;
                uint16_t addr;
                uint16_t elem_addr;
                uint16_t mod_id;
                uint16_t cid;
                uint8_t status;
                uint16_t subs[CONFIG_BT_MESH_MODEL_GROUP_COUNT];
                size_t sub_cnt;
        } mod_sub_get_vnd;
        struct {
                uint16_t addr;
                uint16_t app_idx;
                uint16_t cid;
                uint8_t test_id;
                uint8_t faults[10];
                size_t fault_count;
        } hlth_fault_get;
        struct {
                uint16_t addr;
                uint16_t app_idx;
                uint16_t cid;
                uint8_t test_id;
                uint8_t faults[10];
                size_t fault_count;
        } hlth_fault_clear;
        struct {
                uint16_t addr;
                uint16_t app_idx;
                uint16_t cid;
                uint8_t test_id;
                uint8_t faults[10];
                size_t fault_count;
        } hlth_fault_test;
        struct {
                uint16_t addr;
                uint16_t app_idx;
                uint8_t divisor;
        } hlth_period_get;
        struct {
                uint16_t addr;
                uint16_t app_idx;
                uint8_t divisor;
                uint8_t updated_divisor;
        } hlth_period_set;
        struct {
                uint16_t addr;
                uint16_t app_idx;
                uint8_t attn;
        } hlth_attn_get;
        struct {
                uint16_t addr;
                uint16_t app_idx;
                uint8_t attn;
                uint8_t updated_attn;
        } hlth_attn_set;
        struct {
                int32_t timeout;
        } hlth_timeout_get;
        struct {
                int32_t timeout;
        } hlth_timeout_set;
	struct {
		uint16_t net_idx;
		uint16_t addr;
		struct bt_mesh_cfg_hb_sub sub;
		uint8_t status;
	} hb_sub_get;
	struct {
		uint16_t net_idx;
		uint16_t addr;
		struct bt_mesh_cfg_hb_sub sub;
		uint8_t status;
	} hb_sub_set;
	struct {
		uint16_t net_idx;
		uint16_t addr;
		struct bt_mesh_cfg_hb_pub pub;
		uint8_t status;
	} hb_pub_get;
	struct {
		uint16_t net_idx;
		uint16_t addr;
		struct bt_mesh_cfg_hb_pub pub;
		uint8_t status;
	} hb_pub_set;
};

enum btmesh_sub_type {
        BTMESH_SUB_TYPE_CLI,
        BTMESH_SUB_TYPE_GATEWAY
};

const char* btmesh_parse_opcode(uint32_t opcode);

int btmesh_subscribe(enum btmesh_sub_type type, uint16_t addr);

void btmesh_unsubscribe(enum btmesh_sub_type type, uint16_t addr);

const uint16_t *btmesh_get_subscribe_list(enum btmesh_sub_type);

const char *btmesh_get_sig_model_str(uint16_t model_id);

const char *btmesh_get_blocked_beacon(size_t idx);

int btmesh_block_beacon(uint8_t uuid[UUID_LEN]);

int btmesh_unblock_beacon(uint8_t uuid[UUID_LEN]);

const char *btmesh_get_beacon_uuid(size_t idx);

const char *btmesh_get_beacon_oob(size_t idx);

const uint32_t *btmesh_get_beacon_uri_hash(size_t idx);

uint8_t btmesh_get_pub_period(uint8_t period);

char * btmesh_get_pub_period_unit_str(uint8_t period);

void btmesh_free_node(struct btmesh_node *node);

int btmesh_discover_node(struct btmesh_node *node, uint8_t *status);

int btmesh_perform_op(enum btmesh_op op, union btmesh_op_args* args);

int btmesh_clean_node_key(uint16_t addr, uint16_t app_idx);

int btmesh_init(void);


#ifdef __cplusplus
}
#endif


#endif /* BTMESH_H_ */
```

## src/cli.h
```c
#ifndef CLI_H_
#define CLI_H_


#ifdef __cplusplus
extern "C" {
#endif


#include <bluetooth/mesh.h>


void cli_init(void);

void cli_msg_callback(uint32_t opcode, struct bt_mesh_msg_ctx *ctx, struct net_buf_simple *buf);

void cli_hlth_cb(uint16_t addr, uint8_t test_id, uint16_t cid, uint8_t *faults, size_t fault_count);


#ifdef __cplusplus
}
#endif


#endif /* CLI_H_ */
```

## src/codec.h
```c
#ifndef CODEC_H_
#define CODEC_H_


#ifdef __cplusplus
extern "C" {
#endif

#include <cJSON.h>
#include <cJSON_os.h>

#include "btmesh.h"
#include "util.h"


int codec_encode_beacon_list(char *buf, size_t buf_len);

int codec_encode_prov_result(char *buf, size_t buf_len, int prov_err, uint16_t net_idx,
        uint8_t uuid[UUID_LEN], uint16_t addr, uint8_t num_elem);

int codec_parse_prov(cJSON *op_obj, uint8_t uuid[UUID_LEN], uint16_t *net_idx, uint16_t *addr,
		uint8_t *attn);

int codec_encode_subnet_list(char *buf, size_t buf_len);

int codec_parse_subnet(cJSON *op_obj, uint16_t *net_idx);

int codec_parse_subnet_add(cJSON *op_obj, uint16_t *net_idx, uint8_t net_key[KEY_LEN]);

int codec_encode_app_key_list(char *buf, size_t buf_len);

int codec_parse_app_key(cJSON *op_obj, uint16_t *net_idx, uint16_t *app_idx);

int codec_parse_app_key_add(cJSON *op_obj, uint16_t *net_idx, uint16_t *app_idx,
		uint8_t app_key[KEY_LEN]);

int codec_parse_node_disc(cJSON *op_obj, uint16_t *addr);

int codec_encode_node_list(char *buf, size_t buf_len);

int codec_encode_node_disc(char *buf, size_t buf_len, struct btmesh_node *node, int disc_err,
        uint8_t status);

int codec_parse_node_cfg(cJSON *op_obj, uint16_t* addr);

int codec_parse_subscribe_addrs(cJSON *op_obj, uint16_t **addr_list, int *addr_count);

int codec_encode_subscribe_list(char *buf, size_t buf_len);

int codec_parse_model_msg(cJSON *op_obj, struct bt_mesh_msg_ctx *ctx, struct net_buf_simple *buf);

int codec_encode_model_msg(char *buf, size_t buf_len, uint32_t opcode, struct bt_mesh_msg_ctx *ctx,
                uint8_t *payload, size_t payload_len);

int codec_parse_hlth_fault(cJSON *op_obj, uint16_t *addr, uint16_t *app_idx, uint16_t *cid);

int codec_parse_hlth_fault_test(cJSON *op_obj, uint16_t *addr, uint16_t *app_idx, uint16_t *cid,
		uint8_t *test_id);

int codec_encode_hlth_faults_cur(char *buf, size_t buf_len, uint16_t addr, uint16_t cid,
		uint8_t test_id, uint8_t *faults, size_t fault_count);

int codec_encode_hlth_faults_reg(char *buf, size_t buf_len, uint16_t addr, uint16_t app_idx,
		uint16_t cid, uint8_t test_id, uint8_t *faults, size_t fault_count);

int codec_parse_hlth_period(cJSON *op_obj, uint16_t *addr, uint16_t *app_idx);

int codec_parse_hlth_period_set(cJSON *op_obj, uint16_t *addr, uint16_t *app_idx, uint8_t *div);

int codec_encode_hlth_period(char *buf, size_t buf_len, uint16_t addr, uint8_t div);

int codec_parse_hlth_attn(cJSON *op_obj, uint16_t *addr, uint16_t *app_idx);

int codec_parse_hlth_attn_set(cJSON *op_obj, uint16_t *addr, uint16_t *app_idx, uint8_t *attn);

int codec_encode_hlth_attn(char *buf, size_t buf_len, uint16_t addr, uint8_t attn);

int codec_parse_hlth_timeout(cJSON *op_obj, int32_t *timeout);

int codec_encode_hlth_timeout(char *buf, size_t buf_len, int32_t timeout);


#ifdef __cplusplus
}
#endif


#endif /* CODEC_H_ */
```

## src/config.h
```c
/* the configured options and settings */
#define HW_VERSION_MAJOR 0
#define HW_VERSION_MINOR 9
#define FW_VERSION_MAJOR 0
#define FW_VERSION_MINOR 0
#define FW_VERSION_PATCH be522d5

#define REVSTR2(x)    #x
#define REVSTR(x)     REVSTR2(x)
#define HW_REV_STRING "v" REVSTR(HW_VERSION_MAJOR) "." REVSTR(HW_VERSION_MINOR)
#define FW_REV_STRING "v" REVSTR(FW_VERSION_MAJOR) "." REVSTR(FW_VERSION_MINOR) "." REVSTR(FW_VERSION_PATCH)
#define BUILT_STRING REVSTR(__DATE__) " " REVSTR(__TIME__)
```

## src/error.h
```c
#ifndef ERROR_H_
#define ERROR_H_

#ifdef __cplusplus
extern "C" {
#endif


enum error_type {
    ERROR_CLOUD,
    ERROR_MODEM_RECOVERABLE,
    ERROR_MODEM_IRRECOVERABLE,
    ERROR_LTE_LC,
    ERROR_SYSTEM_FAULT
};


#ifdef __cplusplus
}
#endif


#endif /* ERROR_H_ */
```

## src/gateway.h
```c
#ifndef GATEWAY_H_
#define GATEWAY_H_


#ifdef __cplusplus
extern "C" {
#endif

#include <zephyr.h>
#include <bluetooth/mesh.h>
#include <net/cloud.h>

#include "util.h"
#include "nrf_cloud_transport.h"

uint8_t gateway_handler(const struct cloud_msg *gw_data);

void gateway_node_added(uint16_t net_idx, uint8_t uuid[UUID_LEN], uint16_t addr, uint8_t num_elem);

void gateway_msg_callback(uint32_t opcode, struct bt_mesh_msg_ctx *ctx, struct net_buf_simple *buf);

void gateway_hlth_cb(uint16_t addr, uint8_t test_id, uint16_t cid, uint8_t *faults,
		size_t fault_count);

int gateway_init(struct k_work_q *_work_q);


#ifdef __cplusplus
}
#endif


#endif /* GATEWAY_H_ */
```

## src/gw_cloud.h
```c
#ifndef GW_CLOUD_H_
#define GW_CLOUD_H_


#ifdef __cplusplus
extern "C" {
#endif


#include "error.h"


#define NRF_CLOUD_CLIENT_ID_LEN 10

extern char gateway_id[NRF_CLOUD_CLIENT_ID_LEN+1];

void gw_cloud_error_callback(void);

const char *gw_cloud_get_id(void);

int gw_cloud_init(struct k_work_q *_work_q,
        void(*_error_handler)(enum error_type type, int err));


#ifdef __cplusplus
}
#endif


#endif /* GW_CLOUD_H_ */
```
